## main/Kconfig.projbuild
```kconfig
menu "ESP32 Private Configuration"

	menu "I2C Master"
	    config I2C_MASTER_SCL
	        int "SCL GPIO Num"
	        default 14
	        help
	            GPIO number for I2C Master clock line.
	
	    config I2C_MASTER_SDA
	        int "SDA GPIO Num"
	        default 27
	        help
	            GPIO number for I2C Master data line.
	
	    config I2C_MASTER_PORT_NUM
	        int "Port Number"
	        default 0
	        help
	            Port number for I2C Master device.
	            
	    config I2C_MASTER_FREQUENCY
	        int "Master Frequency"
	        default 100000
	        help
	        	I2C Speed of Master device.
	endmenu

	menu "WIFI Config"
		config ESP_WIFI_SSID
			string "ESP_WIFI_SSID"
			default "putwifihere"
			help
				SSID of the WIFI network.

		config ESP_WIFI_PASSWORD
			string "ESP_WIFI_PASSWORD"
			default "putpasswordhere"
			help
				Password of the WIFI network.

		choice ESP_WIFI_SAE_MODE
			prompt "WPA3 SAE mode selection"
			default ESP_WPA3_SAE_PWE_BOTH
			help
				Select mode for SAE as Hunt and Peck, H2E or both.
			config ESP_WPA3_SAE_PWE_HUNT_AND_PECK
				bool "HUNT AND PECK"
			config ESP_WPA3_SAE_PWE_HASH_TO_ELEMENT
				bool "H2E"
			config ESP_WPA3_SAE_PWE_BOTH
				bool "BOTH"
		endchoice
	
		config ESP_WIFI_PW_ID
			string "PASSWORD IDENTIFIER"
			depends on  ESP_WPA3_SAE_PWE_HASH_TO_ELEMENT|| ESP_WPA3_SAE_PWE_BOTH
			default ""
			help
				password identifier for SAE H2E
	
		config ESP_MAXIMUM_RETRY
			int "Maximum retry"
			default 5
			help
				Set the Maximum retry to avoid station reconnecting to the AP unlimited when the AP is really inexistent.
	
		choice ESP_WIFI_SCAN_AUTH_MODE_THRESHOLD
			prompt "WiFi Scan auth mode threshold"
			default ESP_WIFI_AUTH_WPA2_PSK
			help
				The weakest authmode to accept in the scan mode.
				This value defaults to ESP_WIFI_AUTH_WPA2_PSK incase password is present and ESP_WIFI_AUTH_OPEN is used.
				Please select ESP_WIFI_AUTH_WEP/ESP_WIFI_AUTH_WPA_PSK incase AP is operating in WEP/WPA mode.
	
			config ESP_WIFI_AUTH_OPEN
				bool "OPEN"
			config ESP_WIFI_AUTH_WEP
				bool "WEP"
			config ESP_WIFI_AUTH_WPA_PSK
				bool "WPA PSK"
			config ESP_WIFI_AUTH_WPA2_PSK
				bool "WPA2 PSK"
			config ESP_WIFI_AUTH_WPA_WPA2_PSK
				bool "WPA/WPA2 PSK"
			config ESP_WIFI_AUTH_WPA3_PSK
				bool "WPA3 PSK"
			config ESP_WIFI_AUTH_WPA2_WPA3_PSK
				bool "WPA2/WPA3 PSK"
			config ESP_WIFI_AUTH_WAPI_PSK
				bool "WAPI PSK"
		endchoice
		
	endmenu
	
endmenu
```
